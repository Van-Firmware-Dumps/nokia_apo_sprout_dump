/dts-v1/;

/ {
	compatible = "qcom,holi-rumi", "qcom,holi", "qcom,rumi";
	model = "Qualcomm Technologies, Inc. Holi RUMI";
	qcom,board-id = <0xf 0x0>;
	qcom,msm-id = <0x1c6 0x10000>;

	__fixups__ {
		L12A = "/fragment@4/__overlay__:vdd-io-supply:0", "/fragment@7/__overlay__:vccq2-supply:0";
		L18A = "/fragment@6/__overlay__:vdda-phy-supply:0";
		L22A = "/fragment@6/__overlay__:vdda-pll-supply:0", "/fragment@7/__overlay__:qcom,vddp-ref-clk-supply:0";
		L6E = "/fragment@5/__overlay__:vdd-io-supply:0";
		L7E = "/fragment@4/__overlay__:vdd-supply:0", "/fragment@7/__overlay__:vcc-supply:0";
		L9E = "/fragment@5/__overlay__:vdd-supply:0";
		gcc_ufs_phy_gdsc = "/fragment@7/__overlay__:vdd-hba-supply:0";
		qupv3_se10_i2c = "/fragment@9:target:0";
		qupv3_se9_2uart = "/fragment@8:target:0";
		sdc1_off = "/fragment@4/__overlay__:pinctrl-1:0";
		sdc1_on = "/fragment@4/__overlay__:pinctrl-0:0";
		sdc2_off = "/fragment@5/__overlay__:pinctrl-1:0";
		sdc2_on = "/fragment@5/__overlay__:pinctrl-0:0";
		sdhc_1 = "/fragment@4:target:0";
		sdhc_2 = "/fragment@5:target:0";
		soc = "/fragment@0:target:0";
		tlmm = "/fragment@5/__overlay__:cd-gpios:0";
		tsens0 = "/fragment@1:target:0";
		tsens1 = "/fragment@2:target:0";
		ufshc_mem = "/fragment@7:target:0";
		ufsphy_mem = "/fragment@6:target:0";
		usb0 = "/fragment@3:target:0";
		usb_nop_phy = "/fragment@3/__overlay__:dpdm-supply:0", "/fragment@3/__overlay__/dwc3@4e00000:usb-phy:4";
	};

	__local_fixups__ {

		fragment@3 {

			__overlay__ {

				dwc3@4e00000 {
					usb-phy = <0x0>;
				};
			};
		};
	};

	__symbols__ {
		usb_emu_phy_0 = "/fragment@0/__overlay__/usb_emu_phy@0x04f20000";
	};

	fragment@0 {
		target = <0xffffffff>;

		__overlay__ {

			timer {
				clock-frequency = <0x7a120>;
			};

			timer@f420000 {
				clock-frequency = <0x7a120>;
			};

			usb_emu_phy@0x04f20000 {
				compatible = "qcom,usb-emu-phy";
				phandle = <0x1>;
				qcom,emu-init-seq = <0xffff 0x4 0xfff0 0x4 0x100000 0x20 0x0 0x20 0x101f0 0x20 0x100000 0x3c 0x0 0x3c 0x10060 0x3c 0x0 0x4>;
				reg = <0x4f20000 0x9500>;
			};

			wdog {
				status = "disabled";
			};
		};
	};

	fragment@1 {
		target = <0xffffffff>;

		__overlay__ {
			status = "disabled";
		};
	};

	fragment@2 {
		target = <0xffffffff>;

		__overlay__ {
			status = "disabled";
		};
	};

	fragment@3 {
		target = <0xffffffff>;

		__overlay__ {
			dpdm-supply = <0xffffffff>;

			dwc3@4e00000 {
				dr_mode = "peripheral";
				maximum-speed = "high-speed";
				usb-phy = <0x1 0xffffffff>;
			};
		};
	};

	fragment@4 {
		target = <0xffffffff>;

		__overlay__ {
			cap-mmc-highspeed;
			pinctrl-0 = <0xffffffff>;
			pinctrl-1 = <0xffffffff>;
			pinctrl-names = "default", "sleep";
			qcom,vdd-current-level = <0x0 0x8b290>;
			qcom,vdd-io-always-on;
			qcom,vdd-io-current-level = <0x0 0x4f588>;
			qcom,vdd-io-lpm-sup;
			qcom,vdd-io-voltage-level = <0x1b7740 0x1b7740>;
			qcom,vdd-voltage-level = <0x2d2a80 0x2d2a80>;
			status = "disabled";
			vdd-io-supply = <0xffffffff>;
			vdd-supply = <0xffffffff>;
		};
	};

	fragment@5 {
		target = <0xffffffff>;

		__overlay__ {
			cap-sd-highspeed;
			cd-gpios = <0xffffffff 0x5e 0x1>;
			pinctrl-0 = <0xffffffff>;
			pinctrl-1 = <0xffffffff>;
			pinctrl-names = "default", "sleep";
			qcom,vdd-current-level = <0x0 0xc3500>;
			qcom,vdd-io-current-level = <0x0 0x55f0>;
			qcom,vdd-io-voltage-level = <0x2d2a80 0x2d2a80>;
			qcom,vdd-voltage-level = <0x2d2a80 0x2d2a80>;
			status = "ok";
			vdd-io-supply = <0xffffffff>;
			vdd-supply = <0xffffffff>;
		};
	};

	fragment@6 {
		target = <0xffffffff>;

		__overlay__ {
			compatible = "qcom,ufs-phy-qrbtc-sdm845";
			status = "ok";
			vdda-phy-max-microamp = <0xf5b4>;
			vdda-phy-supply = <0xffffffff>;
			vdda-pll-max-microamp = <0x477c>;
			vdda-pll-supply = <0xffffffff>;
		};
	};

	fragment@7 {
		target = <0xffffffff>;

		__overlay__ {
			limit-rate = <0x1>;
			limit-rx-hs-gear = <0x1>;
			limit-tx-hs-gear = <0x1>;
			qcom,disable-lpm;
			qcom,vddp-ref-clk-max-microamp = <0x64>;
			qcom,vddp-ref-clk-supply = <0xffffffff>;
			rpm-level = <0x0>;
			spm-level = <0x0>;
			status = "ok";
			vcc-max-microamp = <0xc3500>;
			vcc-supply = <0xffffffff>;
			vccq2-max-microamp = <0xc3500>;
			vccq2-supply = <0xffffffff>;
			vdd-hba-fixed-regulator;
			vdd-hba-supply = <0xffffffff>;
		};
	};

	fragment@8 {
		target = <0xffffffff>;

		__overlay__ {
			qcom,rumi_platform;
		};
	};

	fragment@9 {
		target = <0xffffffff>;

		__overlay__ {
			status = "disabled";
		};
	};
};
